// Copyright 2021 Manna Harbour
// https://github.com/manna-harbour/miryoku

#include "../miryoku/custom_config.h"
#include "../miryoku/mapping/36/wing36.h"
#include "../miryoku/miryoku.dtsi"
#include "../miryoku/custom_config.h"
